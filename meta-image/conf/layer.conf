## meta-image/conf/layer.conf
```bitbake
# We have a conf and classes directory, add to BBPATH
BBPATH .= ":${LAYERDIR}"

# We have recipes-* directories, add to BBFILES
BBFILES += "${LAYERDIR}/recipes-*/*/*.bb \
            ${LAYERDIR}/recipes-*/*/*.bbappend"

BBFILE_COLLECTIONS += "meta-image"
BBFILE_PATTERN_meta-image = "^${LAYERDIR}/"
BBFILE_PRIORITY_meta-image = "6"

LAYERDEPENDS_meta-image = "core"
LAYERSERIES_COMPAT_meta-image = "kirkstone"

ENABLE_I2C = "1"
KERNEL_MODULE_AUTOLOAD:rpi += "i2c-dev i2c-bcm2835"
```
